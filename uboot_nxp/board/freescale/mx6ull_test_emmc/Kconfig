## uboot_nxp/board/freescale/mx6ull_test_emmc/Kconfig
```kconfig
if TARGET_MX6ULL_TEST_EMMC

config SYS_BOARD
	default "mx6ull_test_emmc"

config SYS_VENDOR
	default "freescale"

config SYS_SOC
	default "mx6"

config SYS_CONFIG_NAME
	default "mx6ull_test_emmc"

endif
```
